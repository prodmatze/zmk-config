/ {
    key_matrix {
        compatible = "zmk,matrix-transform";
    };

    chosen {
        zmk,kscan = &kscan0;
    };

    kscan0: kscan {
        compatible = "zmk,kscan-gpio-matrix";
        diode-direction = "COL2ROW";

        /* Columns: P1.15, P0.02, P0.09, P0.10, P1.11, P1.13 */
        col-gpios = <&gpio1 15 (GPIO_ACTIVE_LOW | GPIO_PULL_UP)>,
                    <&gpio0  2 (GPIO_ACTIVE_LOW | GPIO_PULL_UP)>,
                    <&gpio0  9 (GPIO_ACTIVE_LOW | GPIO_PULL_UP)>,
                    <&gpio0 10 (GPIO_ACTIVE_LOW | GPIO_PULL_UP)>,
                    <&gpio1 11 (GPIO_ACTIVE_LOW | GPIO_PULL_UP)>,
                    <&gpio1 13 (GPIO_ACTIVE_LOW | GPIO_PULL_UP)>;

        /* Rows: P0.24, P1.00, P0.11, P1.04, P1.06 */
        row-gpios = <&gpio0 24 (GPIO_ACTIVE_LOW | GPIO_PULL_UP)>,
                    <&gpio1  0 (GPIO_ACTIVE_LOW | GPIO_PULL_UP)>,
                    <&gpio0 11 (GPIO_ACTIVE_LOW | GPIO_PULL_UP)>,
                    <&gpio1  4 (GPIO_ACTIVE_LOW | GPIO_PULL_UP)>,
                    <&gpio1  6 (GPIO_ACTIVE_LOW | GPIO_PULL_UP)>;
    };
};
